## CMakeLists.txt
```
cmake_minimum_required(VERSION 3.20.0)
find_package(Zephyr REQUIRED HINTS $ENV{ZEPHYR_BASE})
project(tfc_act LANGUAGES C CXX)

# core/ is consumed as-is: header-only, no heap, no exceptions, no RTTI.
target_include_directories(app PRIVATE ${CMAKE_CURRENT_LIST_DIR}/../../core/include ${CMAKE_CURRENT_LIST_DIR}/../common)
target_sources(app PRIVATE src/main.cpp)

# Replicas must compute the same bits as each other and as the host (ADR-006): no fused multiply-add (-ffast-math stays off).
target_compile_options(app PRIVATE -ffp-contract=off)
```

## Kconfig
```
# SPDX-License-Identifier: MIT
mainmenu "Triplex actuator node (ACT)"

config TFC_GROUND_KEY
	string "Ground-command authentication key (32 hex digits = 128 bits)"
	default "000102030405060708090a0b0c0d0e0f"
	help
	  The shared key for the SipHash-2-4 tag on ground commands (docs/decisions/DECISIONS.md ADR-019). The default is the PUBLIC bench key that the
	  host tools, the tests and the flight computers also use. It protects nothing: provision your own before any real use.

config TFC_SYNC_STAGGER_US
	int "Stagger of the SYNC wait windows between nodes (microseconds)"
	default 500
	range 200 2000
	help
	  The wait for SYNC lasts 1.0 ms plus this much for each node after A, so the lowest node's takeover SYNC is heard by the others before their own
	  windows end (ADR-025). It must exceed the receive latency of a frame. The host's native_sim CAN driver polls its socket every millisecond, so
	  the host board file lengthens it.

config TFC_LAUNCH_SEQUENCE
	bool "Take the vehicle's place (pad or flight) from SYNC's mission frame"
	default n
	help
	  On: Safe entered while the mission frame says the vehicle is on the pad (not launched, or in the countdown) goes to neutral at once; in flight it freezes, holds and ramps (docs/design/SAFE_MODE.md
	  section 5). Set it with the flight computers' CONFIG_TFC_LAUNCH_SEQUENCE: without that, SYNC carries mission frame 0 for ever and ACT would take the vehicle for being on the pad all the time.

config TFC_TEST_SAFE_LINE_AT_FRAME
	int "Test knob: the hardware SAFE line reads as asserted from this SYNC frame on (0: off)"
	default 0
	help
	  A bench aid for the live test of the hardware Safe path on a board without the supervisor (the real input is `safe-gpios` of `tfc_act_lines`). Never set in a flight build.

config TFC_ACT_VOTE_US
	int "Time of ACT's vote within the frame (microseconds after SYNC)"
	default 6500
	range 5500 9000
	help
	  The schedule's ACT slot (ARCHITECTURE section 3): the flight computers' commands are in by then. The host's native_sim CAN driver polls its
	  socket every millisecond, so there the host board file moves it later.

source "Kconfig.zephyr"

config TFC_WATCHDOG_TIMEOUT_MS
	int "Hardware watchdog timeout (ms)"
	default 100
	range 20 4000

config TFC_RESET_LOOP_BOOTS
	int "Short boots in a row that make a reset loop"
	default 3
	range 1 20

config TFC_SHORT_BOOT_S
	int "A boot shorter than this many seconds is short"
	default 60
	range 1 3600
```

## prj.conf
```kconfig
CONFIG_CPP=y
CONFIG_STD_CPP17=y
# Flight-code rules (ARCHITECTURE.md section 6): no exceptions, no RTTI.
CONFIG_CPP_EXCEPTIONS=n
CONFIG_CPP_RTTI=n
# core/ uses <array> and <cmath>, so link the toolchain's full libstdc++ (header-only use, no heap).
CONFIG_REQUIRES_FULL_LIBCPP=y

# Flight bus
CONFIG_CAN=y

# The hardware seams of firmware/common/hw_common.hpp: the watchdog and the reset cause.
CONFIG_WATCHDOG=y
CONFIG_HWINFO=y

# The frame schedule has 0.5 ms slots (ARCHITECTURE.md section 3): 100 us kernel ticks, not the default 10 ms.
CONFIG_SYS_CLOCK_TICKS_PER_SEC=10000

# No dynamic memory (JPL Power of Ten rule 3, docs/verification/CODING_STANDARD.md). With the C library's malloc removed, any
# accidental use of the heap becomes a link error instead of a field failure.
CONFIG_COMMON_LIBC_MALLOC=n

# The frame loop runs on the main thread, with a drain lambda and a few frames on its stack.
CONFIG_MAIN_STACK_SIZE=4096
CONFIG_CBPRINTF_FP_SUPPORT=y
```

## boards/native_sim_native_64.conf
```kconfig
# Run in wall-clock time so the host's SocketCAN peers see a real 100 Hz schedule.
CONFIG_NATIVE_SIM_SLOWDOWN_TO_REAL_TIME=y
# The host CAN driver polls the socket every 1 ms (zephyr/drivers/can/can_native_linux.c): a flight computer's command reaches ACT up to 2 ms after it was
# sent, and ACT locks to SYNC up to 1 ms late. ACT votes at 7.5 ms, just before the flight computers' own 8 ms vote on the host.
CONFIG_TFC_ACT_VOTE_US=7500

# ... and the takeover SYNC of B can reach C up to 1 ms after it was sent, so the stagger of the SYNC windows must exceed that (ADR-025).
CONFIG_TFC_SYNC_STAGGER_US=1500
```

## boards/nucleo_g474re.conf
```kconfig
# A stack that overflows is caught by the MPU as a fatal fault instead of overwriting what lies below it (docs/design/FUTURE_WORK.md 6b item 12).
CONFIG_HW_STACK_PROTECTION=y
```

## boards/nucleo_g474re.overlay
```dts
/* The actuator node's discrete lines to the supervisor (docs/design/SUPERVISOR.md section 4). The same pins as the flight computers' harness (STAGED_BUILD rule 5): FRAME PC8 (CN10 2),
 * KICK PC9 (CN10 1), SAFE PC6 (CN10 4, with an external pull-down: a floating line must read "not asserted"). Check them against ST's user manual (UM2505) before wiring. */
/ {
	tfc_act_lines: tfc-act-lines {
		compatible = "tfc,act-lines";
		frame-gpios = <&gpioc 8 GPIO_ACTIVE_HIGH>;
		kick-gpios = <&gpioc 9 GPIO_ACTIVE_HIGH>;
		safe-gpios = <&gpioc 6 (GPIO_ACTIVE_HIGH | GPIO_PULL_DOWN)>;
	};
};
```

## dts/bindings/tfc,act-lines.yaml
```yaml
# SPDX-License-Identifier: MIT
description: |
  The discrete lines between the actuator node and the supervisor (docs/design/SUPERVISOR.md): FRAME and KICK out, SAFE in. FRAME is a pulse at the start of every frame; KICK a pulse at the
  end of a completed frame, driven only from the end-of-frame path (TFC-FDIR-038); SAFE a hardware "enter Safe now" from the supervisor, or from the FORCE-SAFE override (high is Safe;
  an external pull-down keeps a floating line at "not asserted", docs/design/HARDWARE_OVERRIDE.md section 4).

compatible: "tfc,act-lines"

properties:
  frame-gpios:
    type: phandle-array
    required: true
  kick-gpios:
    type: phandle-array
    required: true
  safe-gpios:
    type: phandle-array
    required: true
```

## src/main.cpp
```c
// SPDX-License-Identifier: MIT
// The actuator node (ADR-023, ADR-024, docs/design/ACT_LOGIC.md). It has no servo behind it: the platform is driven by the Pico, and ACT's job is the vote.
// Every 10 ms frame it
//   t = 0.0 ms  hears SYNC from the sync master and locks its frame to it (it only follows: it is never the master)
//   t = 6.5 ms  takes the three flight computers' commands, votes, judges the nodes, runs its mode (Standby, Nominal, Safe) and sends the voted
//               output and its status on 0x300 (docs/design/PROTOCOL.md)
// From the flight computers' heartbeats it reads their Safe request; ground commands (authenticated, ARMed) lift its Safe and readmit nodes it excluded.
// After a reset that is not a power-on it starts in Safe, holding the output it had, from a record kept in no-init RAM.
// The supervisor's lines (docs/design/SUPERVISOR.md): FRAME rises at the start of every frame, KICK at the end of a completed frame (only after the vote ran, TFC-FDIR-038, and the watchdog is
// serviced at the same place), and the SAFE input is a hardware "enter Safe now" (the supervisor, or the FORCE-SAFE switch).
//
// Include core/ (and so the C++ standard library) BEFORE Zephyr headers: Zephyr defines an `__unused` macro that breaks a glibc header.
#include <array>
#include <cstdint>
#include <cstring>

#include "tfc/act.hpp"
#include "tfc/act_ground.hpp"
#include "tfc/progress.hpp"
#include "tfc/protocol.hpp"
#include "tfc/resetlog.hpp"
#include "tfc/sync_clock.hpp"

#include "hw_common.hpp"

#include <zephyr/drivers/can.h>
#include <zephyr/kernel.h>

namespace {

constexpr unsigned kActNode = 3U;  // ACT's place after A, B and C
constexpr int64_t kPeriodUs = 10000;
constexpr int64_t kVoteUs = CONFIG_TFC_ACT_VOTE_US;
constexpr uint32_t kStatusEveryFrames = 100U;
constexpr bool kLaunch = IS_ENABLED(CONFIG_TFC_LAUNCH_SEQUENCE);  // the mission frame in SYNC says pad or flight
constexpr unsigned kTaskVote = 0U;  // ACT's one monitored task: the vote
constexpr uint32_t kTestSafeAt = CONFIG_TFC_TEST_SAFE_LINE_AT_FRAME;  // bench aid, 0 = off: the SAFE line reads as asserted from this SYNC frame on

const struct device* const can_dev = DEVICE_DT_GET(DT_CHOSEN(zephyr_canbus));

// Survive a reset (no-init RAM, intact because the records have no constructors).
tfc::ResetRecord g_reset_record __noinit;
tfc::ActRecord g_act_record __noinit;

CAN_MSGQ_DEFINE(rx_cmd_msgq, 16);     // the flight computers' commands (0x200 to 0x203)
CAN_MSGQ_DEFINE(rx_sync_msgq, 4);     // SYNC
CAN_MSGQ_DEFINE(rx_ground_msgq, 8);   // ground commands
CAN_MSGQ_DEFINE(rx_hb_msgq, 16);      // heartbeats (0x400 to 0x403)

tfc::Frame to_frame(const can_frame& cf) {
  tfc::Frame f;
  f.id = cf.id;
  f.len = static_cast<uint8_t>(can_dlc_to_bytes(cf.dlc));
  std::memcpy(f.data.data(), cf.data, 8);
  return f;
}

bool send(const tfc::Frame& f) {
  can_frame cf{};
  cf.id = f.id;
  cf.dlc = f.len;
  std::memcpy(cf.data, f.data.data(), 8);
  return can_send(can_dev, &cf, K_MSEC(2), nullptr, nullptr) == 0;
}

bool add_filter(struct k_msgq* q, uint32_t id, uint32_t mask) {
  const can_filter filter{.id = id, .mask = mask, .flags = 0U};
  if (can_add_rx_filter_msgq(can_dev, q, &filter) < 0) {
    printk("cannot add CAN rx filter for id 0x%03x\n", static_cast<unsigned>(id));
    return false;
  }
  return true;
}

bool bus_init() {
  if (!device_is_ready(can_dev)) {
    printk("CAN device not ready\n");
    return false;
  }
  const int br = can_set_bitrate(can_dev, 1000000);
  if (br != 0 && br != -ENOTSUP) {
    printk("can_set_bitrate: %d (continuing)\n", br);
  }
  if (!add_filter(&rx_cmd_msgq, tfc::id::kCmdBase, 0x7FCU) || !add_filter(&rx_sync_msgq, tfc::id::kSync, 0x7FFU) ||
      !add_filter(&rx_ground_msgq, tfc::id::kGround, 0x7FFU) || !add_filter(&rx_hb_msgq, tfc::id::kHeartbeat, 0x7FCU)) {
    return false;
  }
  const int rc = can_start(can_dev);
  if (rc != 0) {
    printk("can_start: %d\n", rc);
    return false;
  }
  return true;
}

bool parse_key(const char* hex, tfc::AuthKey& key) {
  tfc::AuthKey out{};
  for (unsigned i = 0; i < 32U; ++i) {
    const char c = hex[i];
    unsigned v = 0U;
    if (c >= '0' && c <= '9') {
      v = static_cast<unsigned>(c - '0');
    } else if (c >= 'a' && c <= 'f') {
      v = static_cast<unsigned>(c - 'a') + 10U;
    } else if (c >= 'A' && c <= 'F') {
      v = static_cast<unsigned>(c - 'A') + 10U;
    } else {
      return false;
    }
    out[i / 2U] = static_cast<uint8_t>((i % 2U == 0U) ? (v << 4U) : (out[i / 2U] | v));
  }
  if (hex[32] != '\0') {
    return false;
  }
  key = out;
  return true;
}

const char* mode_text(tfc::ActMode m) {
  switch (m) {
    case tfc::ActMode::Standby: return "STANDBY";
    case tfc::ActMode::Nominal: return "NOMINAL";
    case tfc::ActMode::Safe: return "SAFE";
  }
  return "?";
}

const char* phase_text(tfc::SafePhase p) {
  switch (p) {
    case tfc::SafePhase::None: return "-";
    case tfc::SafePhase::Hold: return "hold";
    case tfc::SafePhase::Ramp: return "ramp";
    case tfc::SafePhase::Neutral: return "neutral";
  }
  return "?";
}

const char* cause_text(tfc::SafeCause c) {
  switch (c) {
    case tfc::SafeCause::None: return "none";
    case tfc::SafeCause::LostVotes: return "lost votes";
    case tfc::SafeCause::FcRequest: return "the flight computers' request";
    case tfc::SafeCause::HardwareLine: return "the SAFE line";
    case tfc::SafeCause::Reset: return "a reset";
    case tfc::SafeCause::Integrity: return "an upset in its own mode byte";
  }
  return "?";
}

const char* ground_text(tfc::ActGroundResult r) {
  switch (r) {
    case tfc::ActGroundResult::None: return "not a ground frame";
    case tfc::ActGroundResult::Bad: return "damaged";
    case tfc::ActGroundResult::Unauthentic: return "unauthentic";
    case tfc::ActGroundResult::Replayed: return "replayed";
    case tfc::ActGroundResult::NotForAct: return "not for ACT";
    case tfc::ActGroundResult::NeedsArm: return "needs an ARM first";
    case tfc::ActGroundResult::Armed: return "ARMed";
    case tfc::ActGroundResult::ClearSafe: return "clear-safe";
    case tfc::ActGroundResult::ClearExclusions: return "readmit excluded nodes";
  }
  return "?";
}

}  // namespace

int main() {
  if (!bus_init()) {
    return 1;
  }
  tfc::ActGroundConfig gcfg;
  if (!parse_key(CONFIG_TFC_GROUND_KEY, gcfg.key)) {
    printk("CONFIG ERROR: TFC_GROUND_KEY must be exactly 32 hex digits; using the PUBLIC bench key\n");
  }
  tfc::ActGround ground(gcfg);
  tfc::ActLogic act;
  tfc::HeartbeatMonitor heartbeats;

  fc::hw::Watchdog wdt;
  fc::hw::ActLines lines;
  lines.init();
  tfc::ProgressMonitor progress(1U << kTaskVote);
  tfc::ResetPolicy reset_policy;
  reset_policy.short_boot_frames = static_cast<uint32_t>(CONFIG_TFC_SHORT_BOOT_S) * 100U;
  reset_policy.loop_boots = static_cast<uint32_t>(CONFIG_TFC_RESET_LOOP_BOOTS);
  tfc::ResetLog resets(g_reset_record, reset_policy);
  const tfc::ResetCause cause = fc::hw::reset_cause();
  resets.boot(cause);
  act.boot(cause, g_act_record);
  printk("ACT boot %u since power-on, last reset cause %u, starts in %s%s\n", static_cast<unsigned>(resets.boots()), static_cast<unsigned>(resets.last_cause()),
         mode_text(act.output().mode), act.output().mode == tfc::ActMode::Safe ? " (after a reset: holding the stored output, then ramping to neutral)" : "");

  const int64_t period = k_us_to_ticks_ceil64(kPeriodUs);
  const int64_t window = k_us_to_ticks_ceil64(tfc::sync_window_us(kActNode - 1U, CONFIG_TFC_SYNC_STAGGER_US));  // as long as node C's: ACT never takes over
  tfc::SyncClock sync_clock(tfc::SyncStart::Observer);
  int64_t nominal = k_uptime_ticks() + k_ms_to_ticks_ceil64(200);
  tfc::ActMode last_mode = act.output().mode;
  tfc::SafePhase last_phase = act.output().phase;
  uint8_t last_excluded = 0U;
  uint32_t tx_errors = 0U;

  printk("ACT: following SYNC, voting at %d us. Silent until the first SYNC.\n", static_cast<int>(kVoteUs));

  for (uint32_t cycle = 0;; ++cycle) {
    // ---- the start of the frame: wait for SYNC, up to this node's window ----
    bool heard = false;
    uint32_t heard_number = 0U;
    uint16_t heard_mission = tfc::mission::kNotLaunched;
    int64_t base = nominal;
    can_frame sf;
    while (k_msgq_get(&rx_sync_msgq, &sf, K_TIMEOUT_ABS_TICKS(nominal + window)) == 0) {
      const tfc::DecodedSync d = tfc::unpack_sync(to_frame(sf));
      if (d.ok) {
        heard = true;
        heard_number = d.frame_no;
        heard_mission = d.mission;
        base = k_uptime_ticks();
        break;
      }
    }
    if (!heard) {
      base = k_uptime_ticks();
    }
    const tfc::SyncTick tick = sync_clock.cycle(heard, heard_number, heard_mission);
    const uint32_t k = tick.frame;
    lines.kick(false);  // KICK falls at the start of the frame; it rises again only from the end-of-frame path
    lines.frame(true);
    nominal = base + period;
    if (cycle == 0U && !wdt.start(static_cast<uint32_t>(CONFIG_TFC_WATCHDOG_TIMEOUT_MS)) && DT_HAS_ALIAS(watchdog0)) {
      printk("WATCHDOG: could not be started\n");
    }
    if (!tick.synced) {
      wdt.feed();
      if (cycle % kStatusEveryFrames == 0U) {
        printk("[cycle %u] waiting for SYNC\n", cycle);
      }
      continue;
    }
    if (cycle % kStatusEveryFrames == 0U) {
      resets.running(cycle);
    }
    const uint8_t seq = static_cast<uint8_t>(k);
    act.begin_frame();
    if (kLaunch) {
      act.set_on_pad(!tfc::mission::in_flight(tick.mission));  // read when Safe is entered: on the pad it goes straight to neutral
    }
    heartbeats.begin_frame();
    ground.tick();
    if (cycle == 0U) {
      k_msgq_purge(&rx_cmd_msgq);
      k_msgq_purge(&rx_hb_msgq);
      k_msgq_purge(&rx_ground_msgq);
    }

    // ---- t = 6.5 ms: the commands are in; vote and publish ----
    k_sleep(K_TIMEOUT_ABS_TICKS(base + k_us_to_ticks_ceil64(kVoteUs)));
    can_frame cf;
    while (k_msgq_get(&rx_cmd_msgq, &cf, K_NO_WAIT) == 0) {
      (void)act.on_frame(to_frame(cf));
    }
    while (k_msgq_get(&rx_hb_msgq, &cf, K_NO_WAIT) == 0) {
      (void)heartbeats.on_frame(to_frame(cf));
    }
    while (k_msgq_get(&rx_ground_msgq, &cf, K_NO_WAIT) == 0) {
      const tfc::ActGroundResult r = ground.on_frame(to_frame(cf));
      if (r == tfc::ActGroundResult::ClearSafe) {
        printk("[frame %u] GROUND clear-safe: %s\n", k, act.clear_safe() ? "ACT leaves Safe" : "REFUSED (the votes have not been good for long enough, or a request is still active)");
      } else if (r == tfc::ActGroundResult::ClearExclusions) {
        act.clear_exclusions();
        printk("[frame %u] GROUND reintegrate: ACT readmits the nodes it excluded (they must agree again)\n", k);
      } else if (r != tfc::ActGroundResult::None) {
        printk("[frame %u] GROUND command %s\n", k, ground_text(r));
      }
    }
    act.safe_request(heartbeats.safe_requested(act.output().excluded_nodes));
    lines.frame(false);
    act.hardware_safe(lines.safe() || (kTestSafeAt != 0U && k >= kTestSafeAt));
    const tfc::ActOutput& out = act.end_frame();
    tx_errors += send(tfc::pack_act_out(tfc::to_act_frame(out), seq)) ? 0U : 1U;
    g_act_record = act.record();
    progress.report(kTaskVote);
    if (progress.end_of_frame(true)) {  // the one place the watchdog is serviced, and the one place KICK is raised
      wdt.feed();
      lines.kick(true);
    }

    if (out.mode != last_mode || out.phase != last_phase) {
      printk("[frame %u] ACT %s -> %s (%s), cause: %s\n", k, mode_text(last_mode), mode_text(out.mode), phase_text(out.phase), cause_text(out.cause));
      last_mode = out.mode;
      last_phase = out.phase;
    }
    for (unsigned n = 0; n < tfc::kChannels; ++n) {
      const unsigned bit = 1U << n;
      if (((out.excluded_nodes ^ last_excluded) & bit) != 0U) {
        printk("[frame %u] ACT %s node %c\n", k, (out.excluded_nodes & bit) != 0U ? "EXCLUDED" : "readmitted", 'A' + static_cast<char>(n));
      }
    }
    last_excluded = out.excluded_nodes;
    if (cycle % kStatusEveryFrames == 0U) {
      printk("[frame %u] %s %s pitch %.3f yaw %.3f  voted %u excluded %u held %u  | held_frames %u safe_entries %u refused_clears %u tx_err %u\n", k, mode_text(out.mode),
             phase_text(out.phase), static_cast<double>(out.pitch_deg), static_cast<double>(out.yaw_deg), static_cast<unsigned>(out.voted_nodes),
             static_cast<unsigned>(out.excluded_nodes), out.held ? 1U : 0U, static_cast<unsigned>(act.held_frames()), static_cast<unsigned>(act.safe_entries()),
             static_cast<unsigned>(act.refused_clears()), static_cast<unsigned>(tx_errors));
    }
  }
}
```
